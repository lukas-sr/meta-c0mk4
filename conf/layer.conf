## conf/layer.conf
```bitbake
# We have a conf and classes directory, add to BBPATH
BBPATH .= ":${LAYERDIR}"

# We have recipes-* directories, add to BBFILES
BBFILES += "${LAYERDIR}/recipes-*/*/*.bb \
            ${LAYERDIR}/recipes-*/*/*.bbappend"

BBFILE_COLLECTIONS += "meta-c0mk4"
BBFILE_PATTERN_meta-c0mk4 = "^${LAYERDIR}/"
BBFILE_PRIORITY_meta-c0mk4 = "90"

LAYERDEPENDS_meta-c0mk4 = "core"
LAYERSERIES_COMPAT_meta-c0mk4 = "dunfell"
```
